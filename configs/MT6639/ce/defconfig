## configs/MT6639/ce/defconfig
```kconfig
CONFIG_SUPPORT_WIFI_DL_BT_PATCH=y
CONFIG_MTK_MDDP_SUPPORT=
CONFIG_MTK_WIFI_WFDMA_BK_RS=n
CONFIG_SUPPORT_FW_IDX_LOG_TRANS=y
CONFIG_SUPPORT_CE_COREDUMP=y
CONFIG_UPDATE_STATIC_DBDC_QUOTA=y
CONFIG_TX_MGMT_BY_DATA_Q=n
```

## configs/MT6639/ce_sqc/defconfig
```kconfig
CONFIG_BCN_PROT=y
CONFIG_SUPPORT_MDNS_OFFLOAD=y
CONFIG_TEST_CODE_FOR_MDNS=y
CONFIG_SINGLE_BAND_MLSR_56=y
```
