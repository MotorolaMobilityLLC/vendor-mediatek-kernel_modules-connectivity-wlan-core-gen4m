## configs/MT6639/mobile/defconfig
```kconfig
CONFIG_MTK_WIFI_PMIC_QUERY=y
CONFIG_MTK_WIFI_SUPPORT_UDS_FWDL=y
CONFIG_SUPPORT_PRE_ON_PHY_ACTION=y
CONFIG_CONTROL_ASPM_BY_FW=y
CONFIG_SUPPORT_PCIE_ASPM=y
CONFIG_RX_ZERO_COPY=y
```

## configs/MT6655/mobile/defconfig
```kconfig
#CONFIG_MTK_WIFI_PCIE_MSI_SUPPORT=y
#CONFIG_MTK_WIFI_FW_LOG_MMIO=y
#CONFIG_MTK_WIFI_PMIC_QUERY=y
CONFIG_MTK_WIFI_SUPPORT_UDS_FWDL=y
CONFIG_SUPPORT_PRE_ON_PHY_ACTION=y
CONFIG_DEVICE_SUSPEND_BY_MOBILE=y
```

## configs/MT7925/ce_sqc/defconfig
```kconfig
# Note:  To disable feature, please set CONFIG_AAA=n.
#        "# CONFIG_AAA is not set" won't work.

# For SDK3.8 Dual Card Single Driver
CONFIG_SUPPORT_MULTI_CARD=y
CONFIG_WIFI_RAM_COEX_SPDT_SHR_ANT_CTRL=y
```
